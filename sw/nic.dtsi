/*============================================================================
 * nic.dtsi — 平台设备节点草案  [2026-10-04 建]
 *
 * 依据:客户答复 B3(**平台设备**;总线地址与中断号**由我方分配**)+ B4(**wire 中断**,无 PCIe)
 *       + `规格文档` §1(设备形态)/ §8.1(地址译码)/ §10(中断)/ §2.3(MAC 面)
 * ⚠ 凡 `⚠ 占位/待回填` 字样 = **尚缺事实**,不许当定案(本项目"只抽不发明"纪律)✗
 * ⚠ 与模型的关系:模型**不解析 DTS**;本文件是**给客户 SoC/驱动**的候选口径 ——
 *   模型里"总线"= 平台直连(UART 式内存映射访问,路径 A7 未定)✓
 *============================================================================*/

/ {
	/* ---- NIC(RDMA 引擎)配置窗 ----
	 * 窗大小 = 2MB:地址只译低 21 位段/per-QP/全局三段共用一个窗(§8.1)✓
	 * 基址 0x5000_0000 = 我方定案(B3)✓(与 RTL 台现用一致)
	 */
	nic: nic@50000000 {
		compatible = "rnl,nic";	/* ⚠ 厂商串待定(占位)✗ */
		reg = <0x0 0x50000000 0x0 0x00200000>;
		reg-names = "nic";
		interrupt-parent = <&gic>;		/* ⚠ 按客户 SoC 的中断控制器句柄回填 ✗ */
		/* ★ wire 中断:**一根电平线** `nic_intr`(9 源 OR;§10.1)⇒ 单条 GIC SPI
		 * ⚠ 中断号待我方分配后回填(建议取平台保留段,避开外设现有占用)✗
		 */
		interrupts = <0 0 4>;			/* ⚠ SPI 号占位(=0);4 = level-high(线式电平)★ */
		interrupt-names = "nic_intr";
		/* ⚠ 时钟/复位句柄待客户 SoC 回填(规格 §1"复位/时钟"行同为待抽)✗ */
		status = "disabled";			/* ⚠ 由客户板级 .dts include 后使能 ✓ */
	};

	/* ---- MAC 配置面(APB3;规格 §2.3)----
	 * 已知:字地址 8b、`PADDR[9:2]`→字地址 ⇒ 窗 = **1KB**(2^10 字节)✓
	 * ⚠ SoC 基址待回填;MAC 与 NIC 在 RTL 里是两个配置口(§2/§2.3)✗
	 * 寄存器表 = 套件 `RTL 源`(实跑过 `FRM_LENGTH=9600` 等,见
	 * `md/notes/规格文档` §4)✓
	 */
	mac: ethernet@0 {				/* ⚠ 基址占位(=0)✗ */
		compatible = "rnl,mac";		/* ⚠ 厂商串待定 ✗ */
		reg = <0x0 0x00000000 0x0 0x00000400>;
		reg-names = "mac-apb3";
		status = "disabled";
	};

	/* ⚠ 线侧/对端(SerDes/PCS)不在本驱动范围;如需 phy 句柄由客户板级补 ✗ */
};

/*============================================================================
 * 驱动形态(定案;客户 B1/B3/B4 ⇒ 见 sw 规格 §1)✓
 *   ① **内核侧 = 平台设备驱动**:probe 按 `compatible` 匹配;MMIO `ioremap` 2MB 窗;
 *      wire 中断注册(`request_irq`,电平型;INTR_STS(W1C)读清 —— 见 §10.3)✓
 *   ② **用户侧 = 队列/门铃区映射给用户态**:app 期望**标准 RDMA API**栈(B1:与我方一致)⇒
 *      门铃寄存器(per-QP `SQ_PI_DB`/`RQ_CI_DB`)与 QP 上下文由驱动做**受限 mmap**
 *      (门铃直达,避免每次敲铃进内核)⚠ 具体 mmap 面 = 驱动接口草案,随 P4 定 ✗
 *   ③ **队列/描述符内存** = 普通 DDR(主机内存):WQE 64B / CQE 4B / RQ 数据环 ——
 *      布局见 `nic_regs.h`(WQE/CQE 偏移)与规格 §9 ✓
 * ⚠ 待客户:Linux 版本号(B2:"我方现用",需抄确切号)、验收程序清单(B5,待 pin)✗
 *============================================================================*/
